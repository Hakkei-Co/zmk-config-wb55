#include "five_two.dtsi"

&kscan0 {
	col-gpios
		= <&gpiob   0 GPIO_ACTIVE_HIGH>
		, <&gpiob   1 GPIO_ACTIVE_HIGH>
		, <&gpiob   2 GPIO_ACTIVE_HIGH>
		, <&gpiob  13 GPIO_ACTIVE_HIGH> // default Nucleo has this pin as PB13
		, <&gpiob   4 GPIO_ACTIVE_HIGH>
		;
};