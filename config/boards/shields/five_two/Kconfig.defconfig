## config/boards/shields/five_two/Kconfig.defconfig
```kconfig
if SHIELD_FIVETWO

config ZMK_KEYBOARD_NAME
    default "FiveTwo"

# interrupts are a problem for some reason - check later
config ZMK_KSCAN_MATRIX_POLLING
    default y
    
endif
```

## config/boards/shields/lets_split/Kconfig.defconfig
```kconfig
if SHIELD_LETS_SPLIT_LEFT

config ZMK_KEYBOARD_NAME
    default "Lets split Left"
    
endif

if SHIELD_LETS_SPLIT_RIGHT

config ZMK_KEYBOARD_NAME
    default "Lets split Right"

endif

if SHIELD_LETS_SPLIT_LEFT || SHIELD_LETS_SPLIT_RIGHT

config ZMK_SPLIT
    default y

# interrupts are a problem for some reason - check later
config ZMK_KSCAN_MATRIX_POLLING
    default y

endif
```

## config/boards/shields/lets_split/Kconfig.shield
```kconfig
config SHIELD_LETS_SPLIT_LEFT
    def_bool $(shields_list_contains,lets_split_left)

config SHIELD_LETS_SPLIT_RIGHT
    def_bool $(shields_list_contains,lets_split_right)
```

## config/boards/shields/uno_trio/Kconfig.defconfig
```kconfig
# Copyright (c) 2020 Pete Johanson, Richard Jones
# SPDX-License-Identifier: MIT

if SHIELD_UNO_TRIO

config ZMK_KEYBOARD_NAME
	default "Uno Trio"

# A recent ZMK change has made using interrupts for the
# kscan driver problematic
config ZMK_KSCAN_DIRECT_POLLING
        default y


endif
```
